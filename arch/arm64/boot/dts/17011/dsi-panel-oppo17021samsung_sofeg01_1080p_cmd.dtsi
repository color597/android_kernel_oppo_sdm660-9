/* Copyright (c) 2014, The Linux Foundation. All rights reserved.
 *
 * This program is free software; you can redistribute it and/or modify
 * it under the terms of the GNU General Public License version 2 and
 * only version 2 as published by the Free Software Foundation.
 *
 * This program is distributed in the hope that it will be useful,
 * but WITHOUT ANY WARRANTY; without even the implied warranty of
 * MERCHANTABILITY or FITNESS FOR A PARTICULAR PURPOSE.  See the
 * GNU General Public License for more details.
 */

/*---------------------------------------------------------------------------
 * This file is autogenerated file using gcdb parser. Please do not edit it.
 * Update input XML file to add a new entry or update variable in this file
 * VERSION = "1.0"
 *---------------------------------------------------------------------------*/
&mdss_mdp {
        dsi_oppo17021samsung_sofeg01_s_1080p_cmd: qcom,mdss_dsi_oppo17021samsung_sofeg01_s_1080p_cmd {
        qcom,cont-splash-enabled;
        qcom,mdss-dsi-panel-name = "oppo17021samsung sofeg01_s 1080p cmd mode dsi panel";
        qcom,mdss-dsi-panel-manufacture = "samsung1024";
        qcom,mdss-dsi-panel-version = "SOFEG01_S";
        qcom,mdss-dsi-backlight-version = "SAMSUNG1024";
        qcom,mdss-dsi-backlight-manufacture = "SAMSUNG1024";
        qcom,mdss-dsi-panel-controller = <&mdss_dsi0>;
        qcom,mdss-dsi-panel-type = "dsi_cmd_mode";
        qcom,mdss-dsi-panel-destination = "display_1";
        qcom,mdss-dsi-panel-framerate = <60>;
        qcom,mdss-dsi-virtual-channel-id = <0>;
        qcom,mdss-dsi-stream = <0>;
        qcom,mdss-dsi-panel-width = <1080>;
        qcom,mdss-dsi-panel-height = <2160>;
        qcom,mdss-dsi-h-front-porch = <112>;
        qcom,mdss-dsi-h-back-porch = <96>;
        qcom,mdss-dsi-h-pulse-width = <20>;
        qcom,mdss-dsi-h-sync-skew = <0>;
        qcom,mdss-dsi-v-back-porch = <4>;
        qcom,mdss-dsi-v-front-porch = <20>;
        qcom,mdss-dsi-v-pulse-width = <2>;
        qcom,mdss-dsi-h-left-border = <0>;
        qcom,mdss-dsi-h-right-border = <0>;
        qcom,mdss-dsi-v-top-border = <0>;
        qcom,mdss-dsi-v-bottom-border = <0>;
        qcom,mdss-dsi-bpp = <24>;
        qcom,mdss-dsi-color-order = "rgb_swap_rgb";
        qcom,mdss-dsi-underflow-color = <0xff>;
        qcom,mdss-dsi-border-color = <0>;
        qcom,mdss-dsi-on-command = [05 01 00 00 14 00 02 11 00
                    15 01 00 00 01 00 02 35 00
                    39 01 00 00 01 00 03 FC 5A 5A
                    39 01 00 00 01 00 04 E8 64 08 0C
                    39 01 00 00 01 00 03 FC A5 A5
                    39 01 00 00 01 00 03 F0 5A 5A
                    39 01 00 00 01 00 02 B0 01
                    39 01 00 00 01 00 02 ED 04
                    39 01 00 00 01 00 03 F0 A5 A5
                    39 01 00 00 01 00 03 F0 5A 5A
                    39 01 00 00 01 00 02 BC 01
                    39 01 00 00 01 00 02 B0 01
                    39 01 00 00 01 00 02 BC 12
                    39 01 00 00 01 00 02 B0 2C
                    39 01 00 00 01 00 16 BC B4 03 05 05 FF 02 00 00 FF 00 FF FF F0 00 F0 E0 CE 0F FF FA FF
                    39 01 00 00 01 00 02 B0 42 /* LBR/Skin Enable */
                    39 01 00 00 01 00 02 BC 03 /* LBR/Skin Enable */
                    //39 01 00 00 01 00 02 B0 49 /* LBR Level */
                    //39 01 00 00 01 00 02 BC FF /* lBR Level */
                    39 01 00 00 01 00 02 B0 4B
                    39 01 00 00 01 00 02 BC 49
                    39 01 00 00 01 00 03 F0 A5 A5
                    15 01 00 00 01 00 02 53 20
                    15 01 00 00 01 00 03 51 00 00
                    15 01 00 00 01 00 02 55 00
                    05 01 00 00 78 00 02 29 00];
        qcom,mdss-dsi-off-command = [05 01 00 00 28 00 02 28 00
                    05 01 00 00 78 00 02 10 00];
        qcom,mdss-dsi-lbr-command = [
                    39 01 00 00 01 00 03 F0 5A 5A
                    39 01 00 00 01 00 02 B0 02
                    39 01 00 00 01 00 02 C3 80
                    39 01 00 00 01 00 02 B0 04
                    39 01 00 00 01 00 02 C3 3F
                    39 01 00 00 01 00 03 F0 A5 A5];
        qcom,mdss-dsi-hbm-command = [
                    39 01 00 00 01 00 03 F0 5A 5A
                    39 01 00 00 01 00 02 53 20
                    39 01 00 00 01 00 03 F0 A5 A5];
        //LiPing@Swdp.MultiMedia.Display, 2017/03/14,
        //add seed display parameters from yxq
        qcom,mdss-dsi-seed-closed-command = [
                    39 01 00 00 01 00 03 F0 5A 5A
                    39 01 00 00 01 00 02 BC 01
                    39 01 00 00 01 00 02 B0 01
                    39 01 00 00 01 00 02 BC 12
                    39 01 00 00 01 00 02 B0 2C
                    39 01 00 00 01 00 16 BC B4 03 05 05 FF 02 00 00 FF 00 FF FF F0 00 F0 E0 CE 0F FF FA FF
                    39 01 00 00 01 00 02 B0 42 /* LBR/Skin Enable */
                    39 01 00 00 01 00 02 BC 03 /* LBR/Skin Enable */
                    //39 01 00 00 01 00 02 B0 49 /* LBR Level */
                    //39 01 00 00 01 00 02 BC FF /* lBR Level */
                    39 01 00 00 01 00 02 B0 4B
                    39 01 00 00 01 00 02 BC 49
                    39 01 00 00 01 00 03 F0 A5 A5];
        qcom,mdss-dsi-seed-ui-command = [
                    39 01 00 00 01 00 03 F0 5A 5A
                    39 01 00 00 01 00 02 BC 01
                    39 01 00 00 01 00 02 B0 01
                    39 01 00 00 01 00 02 BC 12
                    39 01 00 00 01 00 02 B0 2C
                    39 01 00 00 01 00 16 BC B4 03 05 05 FF 02 00 00 FF 00 FF FF F0 00 F0 E0 CE 0F FF FA FF
                    39 01 00 00 01 00 02 B0 42 /* LBR/Skin Enable */
                    39 01 00 00 01 00 02 BC 03 /* LBR/Skin Enable */
                    //39 01 00 00 01 00 02 B0 49 /* LBR Level */
                    //39 01 00 00 01 00 02 BC FF /* lBR Level */
                    39 01 00 00 01 00 02 B0 4B
                    39 01 00 00 01 00 02 BC 49
                    39 01 00 00 01 00 03 F0 A5 A5];
        qcom,mdss-dsi-seed-skin-command = [
                    39 01 00 00 01 00 03 F0 5A 5A
                    39 01 00 00 01 00 02 BC 01
                    39 01 00 00 01 00 02 B0 01
                    39 01 00 00 01 00 02 BC 12
                    39 01 00 00 01 00 02 B0 2C
                    39 01 00 00 01 00 16 BC B4 03 05 05 FF 02 00 00 FF 00 FF FF F0 00 F0 E0 CE 0F FF FA FF
                    39 01 00 00 01 00 02 B0 42 /* LBR/Skin Enable */
                    39 01 00 00 01 00 02 BC 03 /* LBR/Skin Enable */
                    //39 01 00 00 01 00 02 B0 49 /* LBR Level */
                    //39 01 00 00 01 00 02 BC FF /* lBR Level */
                    39 01 00 00 01 00 02 B0 4B
                    39 01 00 00 01 00 02 BC 49
                    39 01 00 00 01 00 03 F0 A5 A5];
        qcom,mdss-dsi-on-command-state = "dsi_lp_mode";
        qcom,mdss-dsi-off-command-state = "dsi_hs_mode";
        qcom,mdss-dsi-h-sync-pulse = <1>;
        qcom,mdss-dsi-traffic-mode = "burst_mode";
        qcom,mdss-dsi-lane-map = "lane_map_0123";
        qcom,mdss-dsi-bllp-eof-power-mode;
        qcom,mdss-dsi-bllp-power-mode;
        qcom,mdss-dsi-lane-0-state;
        qcom,mdss-dsi-lane-1-state;
        qcom,mdss-dsi-lane-2-state;
        qcom,mdss-dsi-lane-3-state;
        qcom,mdss-dsi-panel-timings = [f0 3d 3f 00 6a 8f 3f 3e 36 03 04 00];
        qcom,mdss-dsi-te-pin-select = <1>;
        qcom,mdss-dsi-te-v-sync-rd-ptr-irq-line = <0x2c>;
        qcom,mdss-dsi-te-v-sync-continue-lines = <0x3c>;
        qcom,mdss-dsi-te-dcs-command = <1>;
        qcom,mdss-dsi-te-check-enable;
        qcom,mdss-dsi-te-using-te-pin;
        qcom,mdss-dsi-t-clk-post = <0x20>;
        qcom,mdss-dsi-t-clk-pre = <0x34>;
        qcom,mdss-dsi-bl-min-level = <1>;
        qcom,mdss-dsi-bl-max-level = <1023>;
        qcom,mdss-brightness-max-level = <1023>;
        qcom,mdss-dsi-dma-trigger = "trigger_sw";
        qcom,mdss-dsi-mdp-trigger = "trigger_sw";
        qcom,mdss-dsi-bl-pmic-control-type = "bl_ctrl_dcs";
        qcom,mdss-dsi-lp11-init;
        qcom,mdss-dsi-init-delay-us = <5000>;
        qcom,mdss-dsi-reset-sequence = <1 5>, <0 2>, <1 12>;
        /*qcom,mdss-dsi-panel-inverted;*/
        qcom,mdss-dsi-rx-eot-ignore;
        qcom,mdss-dsi-tx-eot-append;
        qcom,esd-check-enabled;
        qcom,mdss-dsi-panel-status-read-length = <1>;
        qcom,mdss-dsi-panel-status-check-mode="reg_read";
        qcom,mdss-dsi-panel-status-command = [06 01 00 01 05 00 02 0A 08];
        qcom,mdss-dsi-panel-status-command-state = "dsi_lp_mode";
        qcom,mdss-dsi-panel-status-value = <0x9e>;
        qcom,mdss-pan-physical-width-dimension = <73>;
        qcom,mdss-pan-physical-height-dimension = <146>;
        //qcom,mdss-dsi-panel-orientation = "180";
    };
};
