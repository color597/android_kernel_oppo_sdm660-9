/* Copyright (c) 2014-2018, The Linux Foundation. All rights reserved.
 *
 * This program is free software; you can redistribute it and/or modify
 * it under the terms of the GNU General Public License version 2 and
 * only version 2 as published by the Free Software Foundation.
 *
 * This program is distributed in the hope that it will be useful,
 * but WITHOUT ANY WARRANTY; without even the implied warranty of
 * MERCHANTABILITY or FITNESS FOR A PARTICULAR PURPOSE.  See the
 * GNU General Public License for more details.
 */

&mdss_mdp {
	dsi_oppo18005samsung_ams641rw01_1080_2340_cmd: qcom,mdss_dsi_oppo18005samsung_ams641rw01_1080_2340_cmd {
		qcom,cont-splash-enabled;
		qcom,panel-supply-entries = <&dsi_panel_pwr_supply_labibb_amoled>;
		qcom,mdss-dsi-panel-name = "oppo18005samsung ams641rw01 1080 2340 cmd mode dsi panel";
		qcom,mdss-dsi-panel-manufacture = "samsung1024";
		qcom,mdss-dsi-panel-version = "SOFEG01_S-QC02";
		qcom,mdss-dsi-backlight-version = "SAMSUNG1024";
		qcom,mdss-dsi-backlight-manufacture = "SAMSUNG1024";
		qcom,mdss-dsi-panel-controller = <&mdss_dsi0>;
		qcom,mdss-dsi-panel-type = "dsi_cmd_mode";
		qcom,mdss-dsi-panel-destination = "display_1";
		qcom,mdss-dsi-panel-framerate = <60>;
		qcom,mdss-dsi-virtual-channel-id = <0>;
		qcom,mdss-dsi-stream = <0>;
		qcom,mdss-dsi-panel-width = <1080>;
		qcom,mdss-dsi-panel-height = <2340>;
		qcom,mdss-dsi-h-front-porch = <48>;
		qcom,mdss-dsi-h-back-porch = <52>;
		qcom,mdss-dsi-h-pulse-width = <48>;
		qcom,mdss-dsi-h-sync-pulse = <1>;
		qcom,mdss-dsi-h-sync-skew = <0>;
		qcom,mdss-dsi-v-back-porch = <28>;
		qcom,mdss-dsi-v-front-porch = <24>;
		qcom,mdss-dsi-v-pulse-width = <4>;
		qcom,mdss-dsi-h-left-border = <0>;
		qcom,mdss-dsi-h-right-border = <0>;
		qcom,mdss-dsi-v-top-border = <0>;
		qcom,mdss-dsi-v-bottom-border = <0>;
		qcom,mdss-dsi-bpp = <24>;
		qcom,mdss-dsi-color-order = "rgb_swap_rgb";
		qcom,mdss-dsi-underflow-color = <0xff>;
		qcom,mdss-dsi-border-color = <0>;
		qcom,mdss-dsi-on-command = [
			39 01 00 00 00 00 03 9F A5 A5
			05 01 00 00 05 00 01 11
			39 01 00 00 00 00 03 9F 5A 5A
			/* FD setting */
			39 01 00 00 00 00 03 F0 5A 5A
			15 01 00 00 00 00 02 B0 01
			15 01 00 00 00 00 02 CD 01
			39 01 00 00 14 00 03 F0 A5 A5
			/* TE vsync ON */
			39 01 00 00 00 00 03 9F A5 A5
			15 01 00 00 00 00 02 35 00
			39 01 00 00 00 00 03 9F 5A 5A
			/* MIC Setting */
			39 01 00 00 00 00 03 F0 5A 5A
			39 01 00 00 00 00 08 EB 17 41 92 0E 10 82 5A
			39 01 00 00 00 00 03 F0 A5 A5
			/* CASET/PASET Setting */
			39 01 00 00 00 00 05 2A 00 00 04 37
			39 01 00 00 00 00 05 2B 00 00 09 23
			/* TSP H_sync Setting*/
			/* 39 01 00 00 00 00 03 F0 5A 5A */
			/* 15 01 00 00 00 00 02 B0 09 */
			/* 15 01 00 00 00 00 03 E8 10 30 */
			/* 39 01 00 00 00 00 03 F0 A5 A5 */
			/* ESD Setting */
			39 01 00 00 00 00 03 FC 5A 5A
			15 01 00 00 00 00 02 B0 01
			15 01 00 00 00 00 02 E3 88
			15 01 00 00 00 00 02 B0 07
			15 01 00 00 00 00 02 ED 67
			39 01 00 00 3C 00 03 FC A5 A5
			/* Backlight Dimming Setting */
			39 01 00 00 00 00 03 F0 5A 5A
			15 01 00 00 00 00 02 B0 07
			15 01 00 00 00 00 02 B7 01
			15 01 00 00 00 00 02 B0 08
			15 01 00 00 00 00 02 B7 12
			39 01 00 00 00 00 03 F0 A5 A5
			15 01 00 00 00 00 02 53 28
			/* ACL off */
			15 01 00 00 00 00 02 55 00
			/* CRC mode enable */
			39 01 00 00 00 00 02 81 90
			39 01 00 00 00 00 03 F0 5A 5A
			39 01 00 00 00 00 02 B0 02
			39 01 00 00 00 00 16 B1 E0 00 08 10 FF 00 00 00 FF 15 FD F0 F0 00 F0 EC F0 00 FF FF FA  /* CRC LUT */
			39 01 00 00 00 00 03 B1 00 00
			39 01 00 00 00 00 03 F0 A5 A5
			/* Seed Tcs On */
			39 01 00 00 00 00 03 F0 5A 5A
			39 01 00 00 00 00 02 B0 23
			39 01 00 00 00 00 02 B3 91
			39 01 00 00 00 00 02 83 80
			39 01 00 00 00 00 03 B3 00 C0
			39 01 00 00 00 00 03 F0 A5 A5
			39 01 00 00 00 00 03 9F A5 A5
			29 01 00 00 00 00 02 29 00
			39 01 00 00 00 00 03 9F 5A 5A];
		qcom,mdss-dsi-off-command = [
			39 01 00 00 00 00 03 9F A5 A5
			05 01 00 00 0A 00 01 28
			05 01 00 00 00 00 01 10
			39 01 00 00 00 00 03 9F 5A 5A
			39 01 00 00 00 00 03 F0 5A 5A
			15 01 00 00 00 00 02 B0 05
			15 01 00 00 00 00 02 F4 01
			15 01 00 00 00 00 02 B0 01
			15 01 00 00 00 00 02 CD 02
			39 01 00 00 96 00 03 F0 A5 A5];
		qcom,mdss-dsi-aod-backlight-command = [
			39 01 00 00 00 00 03 9F A5 A5
			15 01 00 00 0A 00 02 29 00
			39 01 00 00 00 00 03 9F 5A 5A];
		qcom,mdss-dsi-aod-on-command = [
			39 01 00 00 00 00 03 9F A5 A5
			15 01 00 00 0A 00 02 28 00
			15 01 00 00 00 00 02 10 00
			15 01 00 00 0A 00 02 11 00
			39 01 00 00 00 00 03 F0 5A 5A
			15 01 00 00 00 00 02 B0 01
			15 01 00 00 4B 00 02 CD 02
			39 01 00 00 0A 00 02 53 22
			15 01 00 00 01 00 02 35 00
			15 01 00 00 00 00 02 B0 A5
			15 01 00 00 00 00 02 C7 00
			39 01 00 00 01 00 03 F0 A5 A5
			39 01 00 00 00 00 03 9F 5A 5A];
		qcom,mdss-dsi-aod-off-command = [
			39 01 00 00 00 00 03 9F A5 A5
			39 01 00 00 00 00 03 F0 5A 5A
			15 01 00 00 00 00 02 B0 07
			15 01 00 00 00 00 02 B7 01
			15 01 00 00 00 00 02 B0 08
			15 01 00 00 00 00 02 B7 12
			39 01 00 00 00 00 03 F0 A5 A5
			39 01 00 00 00 00 02 53 20
			39 01 00 00 00 00 02 81 90
			39 01 00 00 00 00 03 F0 5A 5A
			39 01 00 00 00 00 02 B0 02
			39 01 00 00 00 00 16 B1 E0 00 08 10 FF 00 00 00 FF 15 FD F0 F0 00 F0 EC F0 00 FF FF FA
			39 01 00 00 00 00 03 B1 00 00
			39 01 00 00 00 00 02 B0 23
			39 01 00 00 00 00 02 B3 91
			39 01 00 00 00 00 02 83 80
			39 01 00 00 00 00 03 B3 00 C0
			39 01 00 00 00 00 03 F0 A5 A5
			05 01 00 00 0A 00 02 29 00
			39 01 00 00 00 00 03 9F 5A 5A];
		qcom,mdss-dsi-lbr-command = [
			39 01 00 00 01 00 03 F0 5A 5A
			39 01 00 00 01 00 02 B0 02
			39 01 00 00 01 00 02 C3 80
			39 01 00 00 01 00 02 B0 04
			39 01 00 00 01 00 02 C3 3F
			39 01 00 00 01 00 03 F0 A5 A5];
		qcom,mdss-dsi-hbm-command = [
			39 01 00 00 00 00 03 F0 5A 5A
			39 01 00 00 00 00 03 51 03 FF
			39 01 00 00 00 00 02 53 20
			39 01 00 00 00 00 03 F0 A5 A5];
		qcom,mdss-dsi-hbm-off-command = [
			15 01 00 00 00 00 02 53 20];
		qcom,mdss-dsi-seed-0-command = [
			/* CRC mode enable */
			39 01 00 00 00 00 02 81 90
			39 01 00 00 00 00 03 F0 5A 5A
			39 01 00 00 00 00 02 B0 02
			39 01 00 00 00 00 16 B1 E0 00 08 10 FF 00 00 00 FF 15 FD F0 F0 00 F0 EC F0 00 FF FF FA  /* CRC LUT */
			39 01 00 00 00 00 03 B1 00 00
			39 01 00 00 00 00 03 F0 A5 A5
			/* Seed Tcs On */
			39 01 00 00 00 00 03 F0 5A 5A
			39 01 00 00 00 00 02 B0 23
			39 01 00 00 00 00 02 B3 91
			39 01 00 00 00 00 02 83 80
			39 01 00 00 00 00 03 B3 00 C0
			39 01 00 00 00 00 03 F0 A5 A5];
		qcom,mdss-dsi-seed-1-command = [
			39 01 00 00 00 00 02 81 90  /* CRC mode enable */
			39 01 00 00 00 00 03 F0 5A 5A
			39 01 00 00 00 00 02 B0 02
			39 01 00 00 00 00 16 B1 E0 05 06 4B DF 15 08 09 D3 56 EF D0 C8 10 C8 F2 EC 1D FF FF FA  /* CRC LUT */
			39 01 00 00 00 00 03 B1 00 00
			39 01 00 00 00 00 03 F0 A5 A5
			39 01 00 00 00 00 03 F0 5A 5A  /* Seed Tcs On */
			39 01 00 00 00 00 02 B0 23
			39 01 00 00 00 00 02 B3 91
			39 01 00 00 00 00 02 83 80
			39 01 00 00 00 00 03 B3 00 C0
			39 01 00 00 00 00 03 F0 A5 A5];
		qcom,mdss-dsi-seed-2-command = [
			39 01 00 00 00 00 02 81 90  /* CRC mode enable */
			39 01 00 00 00 00 03 F0 5A 5A
			39 01 00 00 00 00 02 B0 02
			39 01 00 00 00 00 16 B1 E0 00 08 10 FF 00 00 00 FF 15 FD F0 F0 00 F0 EC F0 00 FF FF FA  /* CRC LUT */
			39 01 00 00 00 00 03 B1 00 00
			39 01 00 00 00 00 03 F0 A5 A5
			39 01 00 00 00 00 03 F0 5A 5A  /* Seed Tcs On */
			39 01 00 00 00 00 02 B0 23
			39 01 00 00 00 00 02 B3 91
			39 01 00 00 00 00 02 83 80
			39 01 00 00 00 00 03 B3 00 C0
			39 01 00 00 00 00 03 F0 A5 A5];
		qcom,mdss-dsi-traffic-mode = "non_burst_sync_pulse";
		qcom,mdss-dsi-lane-map = "lane_map_0123";
		qcom,mdss-dsi-bllp-eof-power-mode;
		qcom,mdss-dsi-bllp-power-mode;
		qcom,mdss-dsi-lane-0-state;
		qcom,mdss-dsi-lane-1-state;
		qcom,mdss-dsi-lane-2-state;
		qcom,mdss-dsi-lane-3-state;
		qcom,mdss-pan-physical-width-dimension = <69>;
		qcom,mdss-pan-physical-height-dimension = <148>;
		qcom,mdss-dsi-wr-mem-start = <0x2c>;
		qcom,mdss-dsi-wr-mem-continue = <0x3c>;
		qcom,mdss-dsi-te-pin-select = <1>;
		qcom,mdss-dsi-te-v-sync-rd-ptr-irq-line = <0x2c>;
		qcom,mdss-dsi-te-v-sync-continue-lines = <0x3c>;
		qcom,mdss-dsi-te-dcs-command = <1>;
		qcom,mdss-dsi-te-check-enable;
		qcom,mdss-dsi-te-using-te-pin;
		qcom,mdss-dsi-t-clk-post = <0x0e>;
		qcom,mdss-dsi-t-clk-pre = <0x35>;
		qcom,mdss-dsi-bl-min-level = <1>;
		qcom,mdss-dsi-bl-max-level = <1023>;
		qcom,mdss-brightness-max-level = <1023>;
		qcom,mdss-dsi-dma-trigger = "trigger_sw";
		qcom,mdss-dsi-mdp-trigger = "trigger_sw";
		qcom,mdss-dsi-bl-pmic-control-type = "bl_ctrl_dcs";
		//qcom,mdss-dsi-lp11-init;
		//qcom,mdss-dsi-init-delay-us = <5000>;
		qcom,mdss-dsi-reset-sequence = <1 5>, <0 2>, <1 12>;
		qcom,mdss-dsi-rx-eot-ignore;
		qcom,mdss-dsi-tx-eot-append;
		qcom,esd-check-enabled;
		qcom,mdss-dsi-panel-status-read-length = <1>;
		qcom,mdss-dsi-panel-status-check-mode="reg_read";
		qcom,mdss-dsi-panel-status-command = [06 01 00 01 05 00 02 0A 08];
		qcom,mdss-dsi-panel-status-command-state = "dsi_hs_mode";
		qcom,mdss-dsi-panel-status-value = <0x9F>;
		qcom,mdss-dsi-panel-phy-timings = [00 22 09 09 25 23 09 09 06 03 04 00];
		qcom,display-topology = <1 0 1>;
		qcom,default-topology-index = <0>;
		qcom,mdss-dsi-lp1-command-state = "dsi_hs_mode";
		qcom,mdss-dsi-nolp-command-state = "dsi_hs_mode";
		qcom,mdss-dsi-on-command-state = "dsi_hs_mode";
		qcom,mdss-dsi-off-command-state = "dsi_hs_mode";
		qcom,mdss-dsi-panel-clockrate = <1029000000>;
		qcom,dynamic-dsi-timing-enable;
	};
};
