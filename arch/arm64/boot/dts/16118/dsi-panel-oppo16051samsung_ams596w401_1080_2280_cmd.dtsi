/* Copyright (c) 2017, The Linux Foundation. All rights reserved.
 *
 * This program is free software; you can redistribute it and/or modify
 * it under the terms of the GNU General Public License version 2 and
 * only version 2 as published by the Free Software Foundation.
 *
 * This program is distributed in the hope that it will be useful,
 * but WITHOUT ANY WARRANTY; without even the implied warranty of
 * MERCHANTABILITY or FITNESS FOR A PARTICULAR PURPOSE.  See the
 * GNU General Public License for more details.
 */

/*---------------------------------------------------------------------------
 * This file is autogenerated file using gcdb parser. Please do not edit it.
 * Update input XML file to add a new entry or update variable in this file
 * VERSION = "1.0"
 *---------------------------------------------------------------------------*/
&mdss_mdp {
		dsi_oppo16051samsung_ams596w401_1080_2280_cmd: qcom,mdss_dsi_oppo16051samsung_ams596w401_1080_2280_cmd {
		qcom,cont-splash-enabled;
		qcom,mdss-dsi-panel-name = "oppo16051samsung ams596w401 1080 2280 cmd mode dsi panel";
		qcom,mdss-dsi-panel-manufacture = "samsung1024";
		qcom,mdss-dsi-panel-version = "SOFEG01_S-QC01";
		qcom,mdss-dsi-backlight-version = "SAMSUNG1024";
		qcom,mdss-dsi-backlight-manufacture = "SAMSUNG1024";
		qcom,mdss-dsi-panel-controller = <&mdss_dsi0>;
		qcom,mdss-dsi-panel-type = "dsi_cmd_mode";
		qcom,mdss-dsi-panel-destination = "display_1";
		qcom,mdss-dsi-panel-framerate = <60>;
		qcom,mdss-dsi-virtual-channel-id = <0>;
		qcom,mdss-dsi-stream = <0>;
		qcom,mdss-dsi-panel-width = <1080>;
		qcom,mdss-dsi-panel-height = <2280>;
		qcom,mdss-dsi-h-front-porch = <80>;
		qcom,mdss-dsi-h-back-porch = <52>;
		qcom,mdss-dsi-h-pulse-width = <20>;
		qcom,mdss-dsi-h-sync-skew = <0>;
		qcom,mdss-dsi-v-back-porch = <16>;
		qcom,mdss-dsi-v-front-porch = <20>;
		qcom,mdss-dsi-v-pulse-width = <4>;
		qcom,mdss-dsi-h-left-border = <0>;
		qcom,mdss-dsi-h-right-border = <0>;
		qcom,mdss-dsi-v-top-border = <0>;
		qcom,mdss-dsi-v-bottom-border = <0>;
		qcom,mdss-dsi-bpp = <24>;
		qcom,mdss-dsi-color-order = "rgb_swap_rgb";
		qcom,mdss-dsi-underflow-color = <0xff>;
		qcom,mdss-dsi-border-color = <0>;
		qcom,mdss-dsi-on-command = [
					05 01 00 00 0A 00 02 11 00
					15 01 00 00 01 00 02 35 00
					39 01 00 00 01 00 03 F0 5A 5A
					39 01 00 00 01 00 02 B0 07
					39 01 00 00 01 00 02 B6 12
					39 01 00 00 01 00 02 53 20
					39 01 00 00 01 00 02 38 00
					39 01 00 00 01 00 03 51 00 00
					39 01 00 00 01 00 02 F7 03
					39 01 00 00 01 00 03 E2 00 85 /*0x41:Seed on + CRC off; 0x85:Seed on+ CRC on */
					39 01 00 00 01 00 02 B0 2C /* CRC LUT */
					39 01 00 00 01 00 16 E2 B0 03 05 04 FF 00 00 00 FF 00 FF FF F2 00 F2 E4 DB 14 FC FD FF
					39 01 00 00 01 00 02 B0 49 /* LBR Enable */
					39 01 00 00 01 00 02 E2 00 /* 0x00: LBR off; 0x01: LBR on */
					39 01 00 00 01 00 02 B0 4A
					39 01 00 00 01 00 02 E2 00 /* 0xFF:255(max); 0x00:0(min) */
					39 01 00 00 01 00 02 B0 4B /* SKIN Enable */
					39 01 00 00 01 00 02 E2 01 /* 0x00: Skin off; 0x01: Skin on */
					39 01 00 00 01 00 02 B0 4D
					39 01 00 00 01 00 02 E2 49 /* 0x01:128(max); 0x80:1(min) */
					39 01 00 00 78 00 03 F0 A5 A5
					05 01 00 00 05 00 02 29 00];
		qcom,mdss-dsi-off-command = [
					39 01 00 00 01 00 03 F0 5A 5A
					39 01 00 00 01 00 02 B0 07
					39 01 00 00 01 00 02 B6 22
					39 01 00 00 01 00 03 F0 A5 A5
					05 01 00 00 28 00 02 28 00
					05 01 00 00 78 00 02 10 00];
		qcom,mdss-dsi-aod-on-command = [
					05 01 00 00 0A 00 02 11 00
					15 01 00 00 01 00 02 35 00
					39 01 00 00 01 00 03 F0 5A 5A
					39 01 00 00 01 00 02 38 00
					39 01 00 00 01 00 03 51 00 00
					39 01 00 00 01 00 02 F7 03
					39 01 00 00 01 00 03 E2 00 85 /*0x41:Seed on + CRC off; 0x85:Seed on+ CRC on */
					39 01 00 00 01 00 02 B0 2C /* CRC LUT */
					39 01 00 00 01 00 16 E2 B0 03 05 04 FF 00 00 00 FF 00 FF FF F2 00 F2 E4 DB 14 FC FD FF
					39 01 00 00 01 00 02 B0 49 /* LBR Enable */
					39 01 00 00 01 00 02 E2 00 /* 0x00: LBR off; 0x01: LBR on */
					39 01 00 00 01 00 02 B0 4A
					39 01 00 00 01 00 02 E2 00 /* 0xFF:255(max); 0x00:0(min) */
					39 01 00 00 01 00 02 B0 4B /* SKIN Enable */
					39 01 00 00 01 00 02 E2 01 /* 0x00: Skin off; 0x01: Skin on */
					39 01 00 00 01 00 02 B0 4D
					39 01 00 00 01 00 02 E2 49 /* 0x01:128(max); 0x80:1(min) */
					39 01 00 00 01 00 02 B0 07
					39 01 00 00 78 00 02 B6 22
					39 01 00 00 0A 00 02 53 22
					39 01 00 00 01 00 03 F0 A5 A5
					05 01 00 00 05 00 02 29 00];
		qcom,mdss-dsi-aod-off-command = [
					05 01 00 00 01 00 02 11 00
					15 01 00 00 01 00 02 35 00
					39 01 00 00 01 00 03 F0 5A 5A
					39 01 00 00 01 00 02 B0 07
					39 01 00 00 01 00 02 B6 12
					39 01 00 00 01 00 02 53 20
					39 01 00 00 01 00 02 38 00
					39 01 00 00 01 00 03 51 00 00
					39 01 00 00 01 00 02 F7 03
					39 01 00 00 01 00 03 E2 00 85 /*0x41:Seed on + CRC off; 0x85:Seed on+ CRC on */
					39 01 00 00 01 00 02 B0 2C /* CRC LUT */
					39 01 00 00 01 00 16 E2 B0 03 05 04 FF 00 00 00 FF 00 FF FF F2 00 F2 E4 DB 14 FC FD FF
					39 01 00 00 01 00 02 B0 49 /* LBR Enable */
					39 01 00 00 01 00 02 E2 00 /* 0x00: LBR off; 0x01: LBR on */
					39 01 00 00 01 00 02 B0 4A
					39 01 00 00 01 00 02 E2 00 /* 0xFF:255(max); 0x00:0(min) */
					39 01 00 00 01 00 02 B0 4B /* SKIN Enable */
					39 01 00 00 01 00 02 E2 01 /* 0x00: Skin off; 0x01: Skin on */
					39 01 00 00 01 00 02 B0 4D
					39 01 00 00 01 00 02 E2 49 /* 0x01:128(max); 0x80:1(min) */
					39 01 00 00 01 00 03 F0 A5 A5
					05 01 00 00 05 00 02 29 00
					];
		qcom,mdss-dsi-lbr-command = [
					39 01 00 00 01 00 03 F0 5A 5A
					39 01 00 00 01 00 02 B0 02
					39 01 00 00 01 00 02 C3 80
					39 01 00 00 01 00 02 B0 04
					39 01 00 00 01 00 02 C3 3F
					39 01 00 00 01 00 03 F0 A5 A5];
		qcom,mdss-dsi-hbm-command = [
					39 01 00 00 01 00 03 F0 5A 5A
					39 01 00 00 01 00 02 53 20
					39 01 00 00 01 00 03 B2 00 40
					39 01 00 00 01 00 02 F7 03
					39 01 00 00 01 00 03 F0 A5 A5];
		qcom,mdss-dsi-seed-0-command = [
					39 01 00 00 01 00 03 F0 5A 5A
					39 01 00 00 01 00 03 E2 00 85 /*0x41:Seed on + CRC off; 0x85:Seed on+ CRC on */
					39 01 00 00 01 00 02 B0 2C /* CRC LUT */
					39 01 00 00 01 00 16 E2 B0 03 05 04 FF 00 00 00 FF 00 FF FF F2 00 F2 E4 DB 14 FC FD FF
					39 01 00 00 01 00 02 B0 49 /* LBR Enable */
					39 01 00 00 01 00 02 E2 00 /* 0x00: LBR off; 0x01: LBR on */
					39 01 00 00 01 00 02 B0 4A
					39 01 00 00 01 00 02 E2 00 /* 0xFF:255(max); 0x00:0(min) */
					39 01 00 00 01 00 02 B0 4B /* SKIN Enable */
					39 01 00 00 01 00 02 E2 01 /* 0x00: Skin off; 0x01: Skin on */
					39 01 00 00 01 00 02 B0 4D
					39 01 00 00 01 00 02 E2 49 /* 0x01:128(max); 0x80:1(min) */
					39 01 00 00 01 00 03 F0 A5 A5];
		qcom,mdss-dsi-seed-1-command = [
					39 01 00 00 01 00 03 F0 5A 5A
					39 01 00 00 01 00 03 E2 00 85 /*0x41:Seed on + CRC off; 0x85:Seed on+ CRC on */
					39 01 00 00 01 00 02 B0 2C /* CRC LUT */
					39 01 00 00 01 00 16 E2 B0 03 05 4B DF 14 08 09 D3 54 EF D0 C4 0F C8 F1 E8 1D FC FD FF
					39 01 00 00 01 00 02 B0 49 /* LBR Enable */
					39 01 00 00 01 00 02 E2 00 /* 0x00: LBR off; 0x01: LBR on */
					39 01 00 00 01 00 02 B0 4A
					39 01 00 00 01 00 02 E2 00 /* 0xFF:255(max); 0x00:0(min) */
					39 01 00 00 01 00 02 B0 4B /* SKIN Enable */
					39 01 00 00 01 00 02 E2 01 /* 0x00: Skin off; 0x01: Skin on */
					39 01 00 00 01 00 02 B0 4D
					39 01 00 00 01 00 02 E2 49 /* 0x01:128(max); 0x80:1(min) */
					39 01 00 00 01 00 03 F0 A5 A5];
		qcom,mdss-dsi-seed-2-command = [
					39 01 00 00 01 00 03 F0 5A 5A
					39 01 00 00 01 00 03 E2 00 85 /*0x41:Seed on + CRC off; 0x85:Seed on+ CRC on */
					39 01 00 00 01 00 02 B0 2C /* CRC LUT */
					39 01 00 00 01 00 16 E2 B0 03 05 04 FF 00 00 00 FF 00 FF FF F2 00 F2 E4 DB 14 FC FD FF
					39 01 00 00 01 00 02 B0 49 /* LBR Enable */
					39 01 00 00 01 00 02 E2 00 /* 0x00: LBR off; 0x01: LBR on */
					39 01 00 00 01 00 02 B0 4A
					39 01 00 00 01 00 02 E2 00 /* 0xFF:255(max); 0x00:0(min) */
					39 01 00 00 01 00 02 B0 4B /* SKIN Enable */
					39 01 00 00 01 00 02 E2 01 /* 0x00: Skin off; 0x01: Skin on */
					39 01 00 00 01 00 02 B0 4D
					39 01 00 00 01 00 02 E2 49 /* 0x01:128(max); 0x80:1(min) */
					39 01 00 00 01 00 03 F0 A5 A5];
		qcom,mdss-dsi-on-command-state = "dsi_lp_mode";
		qcom,mdss-dsi-off-command-state = "dsi_hs_mode";
		qcom,mdss-dsi-h-sync-pulse = <1>;
		qcom,mdss-dsi-traffic-mode = "burst_mode";
		qcom,mdss-dsi-lane-map = "lane_map_0123";
		qcom,mdss-dsi-bllp-eof-power-mode;
		qcom,mdss-dsi-bllp-power-mode;
		qcom,mdss-dsi-lane-0-state;
		qcom,mdss-dsi-lane-1-state;
		qcom,mdss-dsi-lane-2-state;
		qcom,mdss-dsi-lane-3-state;
		qcom,mdss-dsi-panel-timings = [f0 3d 3f 00 6a 8f 3f 3e 36 03 04 00];
		qcom,mdss-dsi-te-pin-select = <1>;
		qcom,mdss-dsi-te-v-sync-rd-ptr-irq-line = <0x2c>;
		qcom,mdss-dsi-te-v-sync-continue-lines = <0x3c>;
		qcom,mdss-dsi-te-dcs-command = <1>;
		qcom,mdss-dsi-te-check-enable;
		qcom,mdss-dsi-te-using-te-pin;
		qcom,mdss-dsi-t-clk-post = <0x08>;
		qcom,mdss-dsi-t-clk-pre = <0x36>;
		qcom,mdss-dsi-bl-min-level = <1>;
		qcom,mdss-dsi-bl-max-level = <1023>;
		qcom,mdss-brightness-max-level = <1023>;
		qcom,mdss-dsi-dma-trigger = "trigger_sw";
		qcom,mdss-dsi-mdp-trigger = "trigger_sw";
		qcom,mdss-dsi-bl-pmic-control-type = "bl_ctrl_dcs";
		qcom,mdss-dsi-lp11-init;
		qcom,mdss-dsi-init-delay-us = <5000>;
		qcom,mdss-dsi-reset-sequence = <1 5>, <0 2>, <1 12>;
		qcom,mdss-dsi-rx-eot-ignore;
		qcom,mdss-dsi-tx-eot-append;
		qcom,esd-check-enabled;
		qcom,mdss-dsi-panel-status-read-length = <1>;
		qcom,mdss-dsi-panel-status-check-mode="reg_read";
		qcom,mdss-dsi-panel-status-command = [06 01 00 01 05 00 02 0A 08];
		qcom,mdss-dsi-panel-status-command-state = "dsi_hs_mode";
		qcom,mdss-dsi-panel-status-value = <0x9C>;
		qcom,mdss-pan-physical-width-dimension = <68>;
		qcom,mdss-pan-physical-height-dimension = <144>;
		qcom,mdss-dsi-panel-clockrate = <1029000000>;
		qcom,dynamic-dsi-timing-enable;
	};
};
