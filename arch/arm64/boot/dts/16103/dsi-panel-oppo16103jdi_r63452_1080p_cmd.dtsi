/* Copyright (c) 2013, The Linux Foundation. All rights reserved.
 *
 * This program is free software; you can redistribute it and/or modify
 * it under the terms of the GNU General Public License version 2 and
 * only version 2 as published by the Free Software Foundation.
 *
 * This program is distributed in the hope that it will be useful,
 * but WITHOUT ANY WARRANTY; without even the implied warranty of
 * MERCHANTABILITY or FITNESS FOR A PARTICULAR PURPOSE.  See the
 * GNU General Public License for more details.
 */

/*---------------------------------------------------------------------------
 * This file is autogenerated file using gcdb parser. Please do not edit it.
 * Update input XML file to add a new entry or update variable in this file
 * VERSION = "1.0"
 *---------------------------------------------------------------------------*/
&mdss_mdp {
        dsi_oppo16103jdi_r63452_1080p_cmd: qcom,mdss_dsi_oppo16103jdi_r63452_1080p_cmd {
                qcom,cont-splash-enabled;
                qcom,mdss-dsi-panel-name = "oppo16103jdi r63452 1080p cmd mode dsi panel";
                qcom,mdss-dsi-panel-manufacture = "JDI";
                qcom,mdss-dsi-panel-version = "R63452";
                qcom,mdss-dsi-panel-controller = <&mdss_dsi0>;
                qcom,mdss-dsi-panel-type = "dsi_cmd_mode";
                qcom,mdss-dsi-panel-destination = "display_1";
                qcom,mdss-dsi-panel-framerate = <60>;
                qcom,mdss-dsi-virtual-channel-id = <0>;
                qcom,mdss-dsi-stream = <0>;
                qcom,mdss-dsi-panel-width = <1080>;
                qcom,mdss-dsi-panel-height = <1920>;
                qcom,mdss-dsi-h-front-porch = <100>;
                qcom,mdss-dsi-h-back-porch = <94>;
                qcom,mdss-dsi-h-pulse-width = <2>;
                qcom,mdss-dsi-h-sync-skew = <0>;
                qcom,mdss-dsi-v-back-porch = <20>;
                qcom,mdss-dsi-v-front-porch = <8>;
                qcom,mdss-dsi-v-pulse-width = <4>;
                qcom,mdss-dsi-h-left-border = <0>;
                qcom,mdss-dsi-h-right-border = <0>;
                qcom,mdss-dsi-v-top-border = <0>;
                qcom,mdss-dsi-v-bottom-border = <0>;
                qcom,mdss-dsi-bpp = <24>;
                qcom,mdss-dsi-color-order = "rgb_swap_rgb";
                qcom,mdss-dsi-underflow-color = <0xff>;
                qcom,mdss-dsi-border-color = <0>;
                //YongPeng.Yi@MultiMedia.Display.LCD.Stability, 2017/03/24,
                //add for lcd color config, remove color enhancement
                qcom,mdss-dsi-on-command = [39 01 00 00 00 00 02 35 00
                    39 01 00 00 00 00 02 B0 04
                    39 01 00 00 00 00 02 D6 01
                    39 01 00 00 00 00 02 51 FF
                    39 01 00 00 00 00 02 53 24
                    39 01 00 00 00 00 02 55 02
                    39 01 00 00 00 00 02 5E 00
                    39 01 00 00 00 00 08 B9 8F 4D 13 20 02 30 30
                    39 01 00 00 00 00 12 C1 84 60 00 A0 84 81 08 00 06 00 00 96 4A 4B A5 A4 56
                    39 01 00 00 00 00 03 C4 70 22
                    39 01 00 00 00 00 09 CB BE E1 FF 61 0D 00 00 3F
                    39 01 00 00 00 00 15 C6 58 2E 2E 05 48 00 00 00 00 00 00 45 0F 00 00 00 00 04 11 06
                    39 01 00 00 00 00 1A CE 11 40 49 53 59 5E 63 68 6E 74 7E 8A 98 A8 BB D0 FF 04 00 04 04 42 00 69 5A
                    39 01 00 00 78 00 02 11 00
                    39 01 00 00 14 00 02 29 00];
                qcom,mdss-dsi-off-command = [05 01 00 00 1E 00 02 28 00
                                        05 01 00 00 78 00 02 10 00];
                qcom,mdss-dsi-on-command-state = "dsi_lp_mode";
                qcom,mdss-dsi-off-command-state = "dsi_hs_mode";
                qcom,mdss-dsi-h-sync-pulse = <1>;
                qcom,mdss-dsi-traffic-mode = "burst_mode";
                qcom,mdss-dsi-lane-map = "lane_map_0123";
                qcom,mdss-dsi-bllp-eof-power-mode;
                qcom,mdss-dsi-bllp-power-mode;
                qcom,mdss-dsi-lane-0-state;
                qcom,mdss-dsi-lane-1-state;
                qcom,mdss-dsi-lane-2-state;
                qcom,mdss-dsi-lane-3-state;
                qcom,mdss-dsi-panel-timings = [E6 38 26 00 68 6C 2A 3C 2C 03 04 00];
                qcom,mdss-dsi-te-pin-select = <1>;
                qcom,mdss-dsi-te-v-sync-rd-ptr-irq-line = <0x2c>;
                qcom,mdss-dsi-te-v-sync-continue-lines = <0x3c>;
                qcom,mdss-dsi-te-dcs-command = <1>;
                //YongPeng.Yi@MultiMedia.Display.LCD.Stability, 2017/03/20,
                //add for TE check enable
                qcom,mdss-dsi-te-check-enable;
                qcom,mdss-dsi-te-using-te-pin;
                qcom,mdss-dsi-t-clk-post = <0x02>;
                qcom,mdss-dsi-t-clk-pre = <0x2B>;
                qcom,mdss-dsi-bl-min-level = <1>;
                qcom,mdss-dsi-bl-max-level = <2047>;
                qcom,mdss-brightness-max-level = <2047>;
                qcom,mdss-dsi-dma-trigger = "trigger_sw";
                qcom,mdss-dsi-mdp-trigger = "trigger_sw";
                qcom,mdss-dsi-bl-pmic-control-type = "bl_ctrl_wled";
                qcom,mdss-dsi-lp11-init;
                qcom,mdss-dsi-init-delay-us = <2000>;
                //YongPeng.Yi@MultiMedia.Display.LCD.Stability, 2017/03/02,
                //add for add for lcd reset timing first high > 12ms (from panel spec)
                qcom,mdss-dsi-reset-sequence = <1 12>, <0 2>, <1 15>;
                qcom,mdss-dsi-rx-eot-ignore;
                qcom,mdss-dsi-tx-eot-append;
                //YongPeng.Yi@MultiMedia.Display.LCD.Stability, 2017/03/08,
                //add for esd reg check count
                qcom,esd-check-enabled;
                qcom,mdss-dsi-panel-status-read-length = <1>;
                qcom,mdss-dsi-panel-status-check-mode="reg_read";
                qcom,mdss-dsi-panel-status-command = [06 01 00 01 05 00 02 0A 08];
                qcom,mdss-dsi-panel-status-command-state = "dsi_lp_mode";
                qcom,mdss-dsi-panel-status-value = <0x38>;
                qcom,mdss-pan-physical-width-dimension = <74>;
                qcom,mdss-pan-physical-height-dimension = <132>;
                qcom,mdss-dsi-cabc-off-command = [15 01 00 00 00 00 02 53 2C
                                                15 01 00 00 00 00 02 55 00
                                                 05 01 00 00 10 00 02 29 00];
                qcom,mdss-dsi-cabc-ui-command = [15 01 00 00 00 00 02 53 2C
                                                 15 01 00 00 00 00 02 55 01
                                                 05 01 00 00 10 00 02 29 00];
                qcom,mdss-dsi-cabc-still-image-command = [15 01 00 00 00 00 02 53 2C
                                                        15 01 00 00 00 00 02 55 02
                                                        05 01 00 00 10 00 02 29 00];
                qcom,mdss-dsi-cabc-video-command = [15 01 00 00 00 00 02 53 2C
                                                15 01 00 00 00 00 02 55 02
                                                05 01 00 00 10 00 02 29 00];
        };
};
